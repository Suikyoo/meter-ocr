## firmware/main/Kconfig.projbuild
```kconfig
menu "Meter OCR"

    config METER_WIFI_SSID
        string "WiFi SSID"
        default ""

    config METER_WIFI_PASSWORD
        string "WiFi password"
        default ""

    config METER_MQTT_URI
        string "MQTT broker URI (empty disables MQTT)"
        default ""
        help
            Example: mqtt://user:pass@192.168.1.10:1883

    config METER_MQTT_PREFIX
        string "MQTT topic prefix"
        default "meter"
        help
            Topics are <prefix>/<device-id>/status and <prefix>/<device-id>/reading.
            The device ID is "meter-" followed by the WiFi MAC address in hex.

    config METER_FLASH_GPIO
        int "Flash LED GPIO (-1 = none)"
        range -1 48
        default -1
        help
            Used only when the display type is LCD. LED displays are read without flash.

endmenu
```
